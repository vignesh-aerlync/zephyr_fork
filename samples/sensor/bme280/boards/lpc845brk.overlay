/*
 * Copyright (c) 2026 Aerlync Labs Inc.
 *
 * SPDX-License-Identifier: Apache-2.0
 */

&i2c1 {
	status = "okay";

	bme280@76 {
		status = "okay";
		compatible = "bosch,bme280";
		reg = <0x76>;
		label = "BME280_I2C";
	};
};
