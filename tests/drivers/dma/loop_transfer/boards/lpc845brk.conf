## tests/drivers/dma/loop_transfer/boards/lpc845brk.conf
```kconfig
# Copyright (c) 2026 Aerlync Labs Inc.
# SPDX-License-Identifier: Apache-2.0

CONFIG_DMA_LOOP_TRANSFER_SIZE=64
```

## tests/drivers/dma/scatter_gather/boards/lpc845brk.conf
```kconfig
# Copyright (c) 2026 Aerlync Labs Inc.
# SPDX-License-Identifier: Apache-2.0

CONFIG_DMA_SG_XFER_SIZE=64
```

## tests/subsys/input/lpc8xx_capt/testcase.yaml
```yaml
# Copyright (c) 2026 Aerlync Labs Inc
# SPDX-License-Identifier: Apache-2.0

tests:
  input.lpc8xx_capt.yhport:
    platform_allow:
      - lpc845brk
    extra_args: DTC_OVERLAY_FILE="boards/lpc845brk_yhport.overlay"
    tags:
      - drivers
      - input

  input.lpc8xx_capt.acomp:
    platform_allow:
      - lpc845brk
    extra_args: DTC_OVERLAY_FILE="boards/lpc845brk_acomp.overlay"
    extra_conf_files:
      - prj_acomp.conf
    tags:
      - drivers
      - input
```
