/*
 * Copyright (c) 2026 Aerlync Labs Inc.
 *
 * SPDX-License-Identifier: Apache-2.0
 */

&flash0 {
	status = "okay";

	partitions {
		#address-cells = <1>;
		#size-cells = <1>;
		compatible = "fixed-partitions";

		/* Test partition for flash driver common tests */
		slot1_partition: partition@8000 {
			label = "slot1";
			reg = <0x8000 DT_SIZE_K(32)>;   /* offset 32KB, size 32KB */
		};
	};
};
