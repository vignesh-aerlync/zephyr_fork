## boards/nxp/lpc845brk/Kconfig.defconfig
```kconfig
# Copyright (c) 2026 Aerlync Labs Inc.
#
# SPDX-License-Identifier: Apache-2.0

if BOARD_LPC845BRK

config BOARD
	default "lpc845brk"

endif # BOARD_LPC845BRK
```

## boards/nxp/lpc845brk/Kconfig.lpc845brk
```kconfig
# Copyright (c) 2026 Aerlync Labs Inc.
#
# SPDX-License-Identifier: Apache-2.0

config BOARD_LPC845BRK
	bool "NXP LPC845-BRK Board"
	select SOC_LPC845
```

## boards/nxp/lpc845brk/board.yml
```yaml
board:
  name: lpc845brk
  full_name: LPC845BRK
  vendor: nxp
  socs:
    - name: lpc845
```

## boards/nxp/lpc845brk/lpc845brk_defconfig
```kconfig
# Copyright (c) 2026, Aerlync Labs Inc.
# SPDX-License-Identifier: Apache-2.0

CONFIG_CLOCK_CONTROL=y

# Enable serial subsystem
CONFIG_SERIAL=y

# Enable LPC84x UART driver
CONFIG_UART_LPC84X=y

# Enable console over UART
CONFIG_CONSOLE=y
CONFIG_UART_CONSOLE=y

CONFIG_COUNTER=y

# Enable GPIO driver
CONFIG_GPIO=y

# Build additional HEX output image
CONFIG_SERIAL=y

CONFIG_CONSOLE=y
CONFIG_UART_CONSOLE=y

CONFIG_GPIO=y

CONFIG_ADC=y

CONFIG_BUILD_OUTPUT_HEX=y
```

## drivers/adc/Kconfig.lpc84x
```kconfig
# Copyright (c) 2026 Aerlync Labs Inc.
# SPDX-License-Identifier: Apache-2.0

config ADC_LPC84X
	bool "LPC84X ADC driver"
	default y
	depends on DT_HAS_NXP_LPC84X_ADC_ENABLED
	help
	  ADC driver for LPC84x SoCs.
```

## drivers/comparator/Kconfig.lpc84x_acomp
```kconfig
# Copyright (c) 2026 Aerlync Labs Inc.
# SPDX-License-Identifier: Apache-2.0

config COMPARATOR_LPC84X_ACOMP
	bool "NXP LPC84X Analog Comparator Driver"
	default y
	depends on DT_HAS_NXP_LPC84X_ACOMP_ENABLED
	help
	  Enable driver for NXP LPC84X analog comparator peripheral.
```

## drivers/counter/Kconfig.mcux_ctimer
```kconfig
# MCUXpresso SDK CTIMER

# Copyright (c) 2021 Toby firth
# SPDX-License-Identifier: Apache-2.0

config COUNTER_MCUX_CTIMER
	bool "MCUX CTIMER driver"
	default y
	depends on DT_HAS_NXP_LPC_CTIMER_ENABLED
	help
	  Enable support for MCUX CTIMER driver.

config COUNTER_MCUX_CTIMER_RESERVE_CHANNEL_FOR_SETTOP
	bool "reserve a ctimer channel to set the top value"
	default y
	depends on COUNTER_MCUX_CTIMER
	help
	  This reserves a CTimer channel to set the top value. Without
	  this the set top value can be set only to the max counter value.

config COUNTER_MCUX_CTIMER_LPC84X
	bool "LPC84x SoC series"
	default y
	depends on SOC_SERIES_LPC84X
	help
	  Enable the Ctimer driver for lpc84x SoC.
```

## drivers/dma/Kconfig.lpc84x
```kconfig
# Copyright (c) 2026 Aerlync Labs Inc.
# SPDX-License-Identifier: Apache-2.0

config DMA_LPC84X
	bool "LPC84X DMA driver"
	default y
	depends on DT_HAS_NXP_LPC84X_DMA_ENABLED
	help
	  DMA driver for LPC84x SoCs.
```

## drivers/i2c/Kconfig.lpc84x
```kconfig
# Copyright (c) 2026 Aerlync Labs Inc.
# SPDX-License-Identifier: Apache-2.0

config I2C_LPC84X
	bool "LPC84x I2C driver"
	default y
	depends on DT_HAS_NXP_LPC84X_I2C_ENABLED
	help
	 Enable I2C support for LPC84X SoCs.
```

## drivers/input/Kconfig.lpc845
```kconfig
# Copyright (c) 2026, Aerlync Labs Inc.
# SPDX-License-Identifier: Apache-2.0

config INPUT_LPC845_CAP_TOUCH
	bool "NXP LPC845 Capacitive Touch"
	default y
	depends on DT_HAS_NXP_LPC845_CAPTOUCH_ENABLED
	help
	  Enable support for the NXP LPC845 Capacitive Touch

choice INPUT_LPC845_CAP_TOUCH_OPERATING_MODE
	prompt "CAPT Operating Mode"
	default INPUT_LPC845_CAP_TOUCH_INTERRUPT_MODE
	depends on INPUT_LPC845_CAP_TOUCH
	help
	  Choose between interrupt-driven or continuous polling mode.

config INPUT_LPC845_CAP_TOUCH_INTERRUPT_MODE
	bool "Interrupt-driven mode"
	help
	  Driver only reacts to hardware interrupts.

config INPUT_LPC845_CAP_TOUCH_POLLING_MODE
	bool "Continuous polling mode"
	help
	  Hardware continuously monitors pins.
endchoice

config INPUT_LPC845_CAP_TOUCH_POLL_INTERVAL_MS
	int "Software polling interval in milliseconds"
	default 50
	depends on INPUT_LPC845_CAP_TOUCH_POLLING_MODE
	help
	  Interval in milliseconds between periodic status polls of the CapTouch
	  controller when continuous polling mode is selected.
```

## drivers/pinctrl/Kconfig.lpc84x
```kconfig
# LPC84x PINCTRL configuration options

# Copyright (c) 2026 Aerlync Labs Inc.
# SPDX-License-Identifier: Apache-2.0

config PINCTRL_LPC84X
	bool "LPC84x pinctrl driver"
	default y
	depends on DT_HAS_NXP_LPC84X_SWM_ENABLED
	help
	Enable the LPC84x pinctrl driver.

config PINCTRL_LPC84X_INIT_PRIORITY
	int "Initialization priority"
	default 40
	depends on PINCTRL_LPC84X
	help
	Wait for clock control to be initialized.
```

## drivers/reset/Kconfig.lpc_syscon
```kconfig
# Copyright 2024 NXP
# SPDX-License-Identifier: Apache-2.0

config RESET_NXP_SYSCON
	bool "NXP Syscon Reset controller driver"
	default y
	depends on DT_HAS_NXP_LPC_SYSCON_RESET_ENABLED
	help
	  Enable the NXP syscon reset controller driver.
	  Syscon is found on LPC parts and LPC heritage parts.

config RESET_NXP_LPC84X_SYSCON
	bool "NXP LPC84x SYSCON reset controller driver"
	default y
	depends on DT_HAS_NXP_LPC84X_SYSCON_RESET_ENABLED
	help
	  Enable the NXP LPC84x SYSCON reset controller driver.
```

## dts/bindings/adc/nxp,lpc84x-adc.yaml
```yaml
# Copyright (c) 2026, Aerlync Labs Inc
# SPDX-License-Identifier: Apache-2.0

description: NXP LPC84x ADC

compatible: "nxp,lpc84x-adc"

include:
  - name: adc-controller.yaml
  - name: pinctrl-device.yaml

properties:
  reg:
    required: true

  interrupts:
    required: true

  clocks:
    required: true

  clk-divider:
    type: int
    required: true
    description: |
      Clock divider for the ADC peripheral clock.
      The ADC functional clock is derived from the main system clock
      divided by this value. Valid range is 1 to 256.

  nxp,burst-mode:
    type: boolean
    description: |
      Enable hardware burst mode for Sequence A.
      When enabled, the ADC will continuously cycle through the selected
      channels in hardware. When disabled, the ADC requires a software
      trigger for each conversion cycle.

  nxp,ref-internal-mv:
    type: int
    default: 3300
    description: |
      Internal reference voltage in millivolts.
      Default is 3300 mV (3.3V) for most LPC84x variants.

  nxp,trigger-source:
    type: int
    default: 0
    description: |
      Selects which of the available hardware trigger sources will cause
      this conversion sequence to be initiated.
      0: No hardware trigger (software trigger).
      1: PININT0_IRQ
      2: PININT1_IRQ
      3: SCT0_OUT3
      4: SCT0_OUT4
      5: T0_MAT3
      6: CMP0_OUT_ADC (Analog comparator output)
      7: GPIO_INT_BMAT

  nxp,trigger-polarity:
    type: int
    default: 1
    description: |
      Select the polarity of the selected input trigger.
      0: Negative edge
      1: Positive edge

io-channel-cells:
  - input
```

## dts/bindings/clock/nxp,lpc-clock-init.yaml
```yaml
# Copyright (c) 2026, Aerlync Labs Inc
# SPDX-License-Identifier: Apache-2.0

description: LPC clock initialization

compatible: "nxp,lpc84x"

properties:
  reg:
    type: array
    required: true
    description: SYSCON register base address and size.

  "#clock-cells":
    type: int
    const: 1
    description: |
      Number of cells in a clock specifier.
      The first cell is the clock ip name.

  enable-fro:
    type: boolean
    description: Power up the FRO oscillator.

  enable-froout:
    type: boolean
    description: Power up the FRO output.

  fro-freq:
    type: string
    enum: ["18M", "24M", "30M"]
    default: "30M"
    description: FRO oscillator output frequency.

  enable-sysosc:
    type: boolean
    description: Power up the system crystal oscillator (SYSOSC).

  extclk-src:
    type: string
    enum: ["sysosc", "clkin"]
    default: "sysosc"
    description: External clock source

  fro-low-power-boot:
    type: boolean
    description: Enable low power boot for FRO.

  sysosc-freq:
    type: int
    description: System oscillator frequency in Hz. Required if enable-sysosc is true.

  extclk-freq:
    type: int
    description: External clock frequency in Hz. Required for extclk-clkin.

  ahb-clk-divider:
    type: int
    default: 1
    description: AHB clock divider.

  mainclk-src:
    type: string
    enum: ["fro", "extclk", "wdosc", "frodiv", "syspll"]
    default: "fro"
    description: Main clock source.
```

## dts/bindings/comparator/nxp,lpc84x-acomp.yaml
```yaml
# Copyright (c) 2026, Aerlync Labs Inc
# SPDX-License-Identifier: Apache-2.0

description: |
  NXP LPC84X Analog Comparator (ACOMP)

compatible: "nxp,lpc84x-acomp"

include:
  - base.yaml
  - pinctrl-device.yaml

properties:
  reg:
    required: true

  interrupts:
    required: true

  positive-input:
    required: true
    type: int
    enum: [0, 1, 2, 3, 4, 5, 6, 7]
    description: |
      Positive comparator input.
      0 = Voltage ladder output
      1 = ACMP_I1 (PIO0_0)
      2 = ACMP_I2 (PIO0_1)
      3 = ACMP_I3 (PIO0_14)
      4 = ACMP_I4 (PIO0_23)
      5 = ACMP_I5 (PIO0_30)
      6 = Internal reference voltage
      7 = DACOUT0

  negative-input:
    required: true
    type: int
    enum: [0, 1, 2, 3, 4, 5, 6, 7]
    description: |
      Negative comparator input.
      0 = Voltage ladder output
      1 = ACMP_I1 (PIO0_0)
      2 = ACMP_I2 (PIO0_1)
      3 = ACMP_I3 (PIO0_14)
      4 = ACMP_I4 (PIO0_23)
      5 = ACMP_I5 (PIO0_30)
      6 = Internal reference voltage
      7 = DACOUT0

  hysteresis:
    type: int
    default: 0
    enum: [0, 1, 2, 3]
    description: |
      Hysteresis level selection:
      0 = none
      1 = 5mV
      2 = 10mV
      3 = 20mV

  ladder-enable:
    type: boolean
    description: |
      Enable voltage ladder.

  ladder-value:
    type: int
    default: 0
    description: |
      Voltage ladder value (0-31).

  ladder-vref:
    type: int
    default: 0
    enum: [0, 1]
    description: |
      Voltage ladder reference.
        0 = VDD
        1 = VDDCMP
```

## dts/bindings/dac/nxp,lpc84x-dac.yaml
```yaml
# Copyright (c) 2026 Aerlync Labs Inc.
# SPDX-License-Identifier: Apache-2.0

description: |
  NXP LPC84x 10-bit Digital-to-Analog Converter (DAC).
  The LPC84x DAC uses a resistor string architecture with a buffered
  output. It supports a selectable speed vs. power tradeoff via the
  BIAS bit in the Control Register (CR).

compatible: "nxp,lpc84x-dac"

include: [dac-controller.yaml, pinctrl-device.yaml]

properties:
  reg:
    required: true

  clocks:
    required: true
    description: |
      Clock source for the DAC peripheral.

  interrupts:
    description: |
      Optional interrupt for the DAC DMA/Timer timeout requests.

  low-power-mode:
    type: boolean
    description: |
      If present, sets the BIAS bit to 1. This configures the DAC for a
      settling time of 2.5 us and a maximum current of 350 uA (400 kHz max
      update rate). If omitted, the DAC defaults to a settling time of 1 us
      and a maximum current of 700 uA (1 MHz max update rate).

  "#io-channel-cells":
    const: 1

io-channel-cells:
  - output
```

## dts/bindings/dma/nxp,lpc84x-dma.yaml
```yaml
# Copyright (c) 2026 Aerlync Labs Inc
# SPDX-License-Identifier: Apache-2.0

description: LPC84X DMA Controller

compatible: "nxp,lpc84x-dma"

include: dma-controller.yaml

dma-cells:
  - channel

properties:
  reg:
    required: true

  clocks:
    required: true

  interrupts:
    required: true
```

## dts/bindings/flash_controller/nxp,iap-fmc84x.yaml
```yaml
# Copyright (c) 2026 Aerlync Labs Inc
# SPDX-License-Identifier: Apache-2.0

description: |
  NXP LPC84x on chip flash controller (ROM IAP, FMC)

compatible: "nxp,iap-fmc84x"

include:
  - flash-controller.yaml
  - base.yaml

properties:
  clocks:
    required: true

  flash-access-time:
    type: int
    required: true
    default: 2
    enum: [0, 1, 2]
    description: |
      Controls flash read wait-state count written to `FLASHCFG.FLASHTIM`
      0 = 1 system clock, 18 MHz
      1 = 2 system clocks, 24 MHz
      2 = 3 system clocks This is the hardware reset default. 30 MHz
      Must match the actual system clock frequency to avoid flash read errors.
```

## dts/bindings/i2c/nxp,lpc84x-i2c.yaml
```yaml
# Copyright (c) 2026 Aerlync Labs Inc
# SPDX-License-Identifier: Apache-2.0

description: LPC84x I2C Controller

compatible: "nxp,lpc84x-i2c"

include: [i2c-controller.yaml, pinctrl-device.yaml]

properties:
  reg:
    required: true

  interrupts:
    required: true

  clocks:
    required: true

  clock-source:
    type: string
    enum: ["fro", "mainclk", "frg0", "frg1", "frodiv"]
    default: "fro"
    description: I2C clock source.
```

## dts/bindings/input/nxp,lpc845-captouch.yaml
```yaml
# Copyright (c) 2026 Aerlync Labs Inc
# SPDX-License-Identifier: Apache-2.0

description: NXP LPC845 Capacitive Touch

compatible: "nxp,lpc845-captouch"

include: [base.yaml, pinctrl-device.yaml]

properties:
  reg:
    required: true

  interrupts:
    required: true

  clocks:
    required: true

  clock-source:
    type: string
    enum: ["fro", "main", "syspll", "frodiv", "wdt"]
    default: "fro"
    description: CAPT clock source

  clock-divider:
    type: int
    required: true
    description: CAPT Functional clock divider (0-15).

  touch-lower:
    type: boolean
    description: Enable Touch-Lower mode.

  threshold:
    type: int
    required: true
    description: Touch detection threshold (0-4095).

  poll-count:
    type: int
    default: 250
    description: Time delay between polling rounds (0-255)

  xpins:
    type: array
    required: true
    description: |
      List of CAPT X pins to enable (e.g. <0> for X0).
      These pins CAPT X0 to CAPT X8 are physically mapped to the hardware CAPT controller.

  inactive-xpins-mode:
    type: int
    enum: [0, 1]
    default: 1
    description: |
      Mode of inactive X pins:
      0: High-Z
      1: Driven Low

  measurement-delay:
    type: int
    enum: [0, 1, 2, 3]
    default: 0
    description: |
      Delay before measuring voltage:
      0: No Wait
      1: 3 FCLKs
      2: 5 FCLKs
      3: 9 FCLKs

  reset-delay:
    type: int
    enum: [0, 1, 2, 3]
    default: 3
    description: |
      Delay of resetting or draining capacitor:
      0: No Wait
      1: 3 FCLKs
      2: 5 FCLKs
      3: 9 FCLKs
```

## dts/bindings/pinctrl/nxp,lpc84x-swm.yaml
```yaml
# Copyright (c) 2026 Aerlync Labs Inc.
# SPDX-License-Identifier: Apache-2.0

description: |
  LPC84x Switch Matrix (SWM) and I/O Configuration (IOCON) pinctrl.

compatible: "nxp,lpc84x-swm"

include: [pinctrl-device.yaml, base.yaml]

properties:
  reg:
    required: true

child-binding:
  description: LPC84x pinctrl child node
  child-binding:
    description: LPC84x pinctrl group
    include:
      - name: pincfg-node.yaml
        property-allowlist: [bias-pull-up, bias-pull-down, drive-open-drain]
    properties:
      pinmux:
        required: true
        type: array
        description: Array of pinmux values.
      nxp,invert:
        type: boolean
        description: Invert input.
      nxp,hysteresis:
        type: boolean
        description: Enable input hysteresis.
```

## dts/bindings/reset/nxp,lpc84x-syscon-reset.yaml
```yaml
# Copyright 2026 Aerlync Labs Inc.
# SPDX-License-Identifier: Apache-2.0

description: |
  NXP LPC84x SYSCON peripheral reset controller.
  Manages resets via PRESETCTRL0/1 using read-modify-write.
  Reset ID encoding: ((register_index << 16) | bit_position).

compatible: "nxp,lpc84x-syscon-reset"

include: [reset-controller.yaml]

properties:
  "#reset-cells":
    const: 1

reset-cells:
  - id
```

## soc/nxp/lpc/lpc84x/Kconfig.defconfig
```kconfig
# Copyright (c) 2026 Aerlync Labs Inc.
#
# SPDX-License-Identifier: Apache-2.0

if SOC_SERIES_LPC84X

config NUM_IRQS
	default 48

config SYS_CLOCK_HW_CYCLES_PER_SEC
	default 30000000

config CPU_CORTEX_M_HAS_VTOR
	default y

# Enable SysTick timer for kernel timing
config SYS_CLOCK_EXISTS
	default y

config CORTEX_M_SYSTICK
	default y

endif # SOC_SERIES_LPC84X
```
