## soc/nxp/lpc/lpc84x/Kconfig.soc
```kconfig
# Copyright (c) 2026 Aerlync Labs Inc.
#
# SPDX-License-Identifier: Apache-2.0

config SOC_SERIES_LPC84X
	bool
	select SOC_FAMILY_LPC

config SOC_SERIES
	default "lpc84x" if SOC_SERIES_LPC84X

config SOC_LPC845
	bool
	select SOC_SERIES_LPC84X

config SOC
	default "lpc845" if SOC_LPC845
```

## tests/drivers/dma/cyclic/boards/lpc845brk.conf
```kconfig
# Copyright (c) 2026 Aerlync Labs Inc.
# SPDX-License-Identifier: Apache-2.0

CONFIG_DMA_CYCLIC_XFER_SIZE=64
```
